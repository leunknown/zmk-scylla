&spi1 {
	compatible = "nordic,nrf-spim";
	status = "okay";
	//mosi-pin = <8>;
	// Unused pins, needed for SPI definition, but not used by the ws2812 driver itself.
	//sck-pin = <5>;
	//miso-pin = <7>;

	led_strip: ws2812@0 {
		compatible = "worldsemi,ws2812-spi";
		label = "WS2812";

		/* SPI */
		reg = <0>; /* ignored, but necessary for SPI bindings */
		spi-max-frequency = <4000000>;

		/* WS2812 */
		/* Add the required color mapping for modern ZMK */
        /* 1 = Green, 2 = Red, 3 = Blue. This is the GRB mapping. */
        color-mapping = <2 1 3>;

        /* Updated timing frames for better compatibility with Zephyr 3.x+ */
        spi-one-frame = <0x7c>;
        spi-zero-frame = <0x60>;
	};
};

/ {
	chosen {
		zmk,underglow = &led_strip;
	};
};
